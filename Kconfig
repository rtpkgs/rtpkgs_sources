## Kconfig
```kconfig
menu "rtpkgs online packages"

source "$PKGS_DIR/rtpkgs_sources/cstring/Kconfig"
source "$PKGS_DIR/rtpkgs_sources/argparse/Kconfig"
source "$PKGS_DIR/rtpkgs_sources/libbmpread/Kconfig"
source "$PKGS_DIR/rtpkgs_sources/libutils/Kconfig"
source "$PKGS_DIR/rtpkgs_sources/sam/Kconfig"
source "$PKGS_DIR/rtpkgs_sources/libcallback/Kconfig"

endmenu
```

## argparse/Kconfig
```kconfig
# Kconfig file for package argparse
menuconfig PKG_USING_ARGPARSE
    bool "argparse: command-line arguments parsing library"
    default n

if PKG_USING_ARGPARSE

    config PKG_ARGPARSE_PATH
        string
        default "/rtpkgs_sources/argparse"

    choice
        prompt "Version"
        default PKG_USING_ARGPARSE_LATEST_VERSION
        help
            Select the package version

        config PKG_USING_ARGPARSE_V101
            bool "v1.0.1"

        config PKG_USING_ARGPARSE_LATEST_VERSION
            bool "latest"
    endchoice
          
    config PKG_ARGPARSE_VER
       string
       default "v1.0.1"    if PKG_USING_ARGPARSE_V101
       default "latest"    if PKG_USING_ARGPARSE_LATEST_VERSION

    config ARGPARSE_USING_DEMO
        bool
        prompt "argparse demo example"
        default n

endif
```

## cstring/Kconfig
```kconfig
# Kconfig file for package cstring
menuconfig PKG_USING_CSTRING
    bool "cstring: a simple C string lib"
    default n

if PKG_USING_CSTRING

    config PKG_CSTRING_PATH
        string
        default "/rtpkgs_sources/cstring"

    choice
        prompt "Version"
        default PKG_USING_CSTRING_LATEST_VERSION
        help
            Select the package version

        config PKG_USING_CSTRING_V100
            bool "v1.0.0"

        config PKG_USING_CSTRING_LATEST_VERSION
            bool "latest"
    endchoice
          
    config PKG_CSTRING_VER
       string
       default "v1.0.0"    if PKG_USING_CSTRING_V100
       default "latest"    if PKG_USING_CSTRING_LATEST_VERSION

    config CSTRING_USING_DEMO
        bool
        prompt "cstring demo example"
        default n

endif
```

## libbmpread/Kconfig
```kconfig
# Kconfig file for package libbmpread
menuconfig PKG_USING_LIBBMPREAD
    bool "libbmpread: tiny, fast bitmap (.bmp) image file loader"
    default n

if PKG_USING_LIBBMPREAD

    config PKG_LIBBMPREAD_PATH
        string
        default "/rtpkgs_sources/libbmpread"

    choice
        prompt "Version"
        default PKG_USING_LIBBMPREAD_LATEST_VERSION
        help
            Select the package version

        config PKG_USING_LIBBMPREAD_V100
            bool "v1.0.0"

        config PKG_USING_LIBBMPREAD_LATEST_VERSION
            bool "latest"
    endchoice
          
    config PKG_LIBBMPREAD_VER
       string
       default "v1.0.0"    if PKG_USING_LIBBMPREAD_V100
       default "latest"    if PKG_USING_LIBBMPREAD_LATEST_VERSION

    #config LIBBMPREAD_USING_DEMO
    #    bool
    #    prompt "libbmpread demo example"
    #    default n

endif
```

## libcallback/Kconfig
```kconfig
# Kconfig file for package libcallback
menuconfig PKG_USING_LIBCALLBACK
    bool "libcallback: the library of sync and asyn callback based on rt-thread"
    default n

if PKG_USING_LIBCALLBACK

    config PKG_LIBUTILS_PATH
        string
        default "/rtpkgs_sources/libcallback"

    choice
        prompt "Version"
        default PKG_USING_LIBCALLBACK_LATEST_VERSION
        help
            Select the package version

        config PKG_USING_LIBCALLBACK_V100
            bool "v1.0.0"

        config PKG_USING_LIBCALLBACK_LATEST_VERSION
            bool "latest"
    endchoice
          
    config PKG_LIBUTILS_VER
       string
       default "v1.0.0"    if PKG_USING_LIBCALLBACK_V100
       default "latest"    if PKG_USING_LIBCALLBACK_LATEST_VERSION

    #config LIBCALLBACK_USING_DEMO
    #    bool
    #    prompt "libcallback demo example"
    #    default n

endif
```

## libstm32hal/Kconfig
```kconfig
# Kconfig file for package libstm32hal
menuconfig PKG_USING_LIBSTM32HAL
    bool "libstm32hal: STM32 HAL static link library for rt-thread"
    default n

if PKG_USING_LIBSTM32HAL

    config PKG_LIBSTM32HAL_PATH
        string
        default "/rtpkgs_sources/libstm32hal"

    choice
        prompt "Version"
        default PKG_USING_LIBSTM32HAL_V010
        help
            Select the package version

        config PKG_USING_LIBSTM32HAL_V010
            bool "v0.1.0"

        config PKG_USING_LIBSTM32HAL_LATEST_VERSION
            bool "latest"
    endchoice
          
    config PKG_LIBSTM32HAL_VER
       string
       default "v0.1.0"    if PKG_USING_LIBSTM32HAL_V010
       default "latest"    if PKG_USING_LIBSTM32HAL_LATEST_VERSION

    #config LIBSTM32HAL_USING_DEMO
    #    bool
    #    prompt "libstm32hal demo example"
    #    default n

    config LIBSTM32HAL_USING_STATIC_LIB
        bool
        prompt "libstm32hal using static lib"
        default y

endif
```

## libtest/Kconfig
```kconfig
# Kconfig file for package libtest
menuconfig PKG_USING_LIBTEST
    bool "libtest: RT-Thread test library (rough version)"
    select PKG_USING_OPTPARSE
    default n

if PKG_USING_LIBTEST

    config PKG_LIBTEST_PATH
        string
        default "/rtpkgs_sources/libtest"

    choice
        prompt "Version"
        default PKG_USING_LIBTEST_LATEST_VERSION
        help
            Select the package version

        config PKG_USING_LIBTEST_V100
            bool "v1.0.0"

        config PKG_USING_LIBTEST_LATEST_VERSION
            bool "latest"
    endchoice
          
    config PKG_LIBTEST_VER
       string
       default "v1.0.0"    if PKG_USING_LIBTEST_V100
       default "latest"    if PKG_USING_LIBTEST_LATEST_VERSION

    #config LIBTEST_USING_DEMO
    #    bool
    #    prompt "libtest demo example"
    #    default n

endif
```

## libutils/Kconfig
```kconfig
# Kconfig file for package libutils
menuconfig PKG_USING_LIBUTILS
    bool "libutils: RT-Thread small tools library (rough version)"
    default n

if PKG_USING_LIBUTILS

    config PKG_LIBUTILS_PATH
        string
        default "/rtpkgs_sources/libutils"

    choice
        prompt "Version"
        default PKG_USING_LIBUTILS_LATEST_VERSION
        help
            Select the package version

        config PKG_USING_LIBUTILS_V110
            bool "v1.1.0"

        config PKG_USING_LIBUTILS_LATEST_VERSION
            bool "latest"
    endchoice
          
    config PKG_LIBUTILS_VER
       string
       default "v1.1.0"    if PKG_USING_LIBUTILS_V110
       default "latest"    if PKG_USING_LIBUTILS_LATEST_VERSION

    #config LIBUTILS_USING_DEMO
    #    bool
    #    prompt "libutils demo example"
    #    default n

endif
```

## sam/Kconfig
```kconfig
# Kconfig file for package sam
menuconfig PKG_USING_SAM
    bool "sam: Software Automatic Mouth - Tiny Speech Synthesizer for RT-Thread"
    default n

if PKG_USING_SAM

    config PKG_SAM_PATH
        string
        default "/rtpkgs_sources/sam"

    choice
        prompt "Version"
        default PKG_USING_SAM_LATEST_VERSION
        help
            Select the package version

        config PKG_USING_SAM_V100
            bool "v1.0.0"

        config PKG_USING_SAM_LATEST_VERSION
            bool "latest"
    endchoice
          
    config PKG_SAM_VER
       string
       default "v1.0.0"    if PKG_USING_SAM_V100
       default "latest"    if PKG_USING_SAM_LATEST_VERSION

    #config SAM_USING_DEMO
    #    bool
    #    prompt "sam demo example"
    #    default n

endif
```

## z_event/Kconfig
```kconfig
# Kconfig file for package z_event
menuconfig PKG_USING_Z_EVENT
    bool "z_event: a generic unlimited event management package"
    default n

if PKG_USING_Z_EVENT

    config PKG_Z_EVENT_PATH
        string
        default "/rtpkgs_sources/z_event"

    choice
        prompt "Version"
        default PKG_USING_Z_EVENT_LATEST_VERSION
        help
            Select the package version

        config PKG_USING_Z_EVENT_V100
            bool "v1.0.0"

        config PKG_USING_Z_EVENT_LATEST_VERSION
            bool "latest"
    endchoice
          
    config PKG_Z_EVENT_VER
       string
       default "v1.0.0"    if PKG_USING_Z_EVENT_V100
       default "latest"    if PKG_USING_Z_EVENT_LATEST_VERSION

    #config Z_EVENT_USING_DEMO
    #    bool
    #    prompt "z_event demo example"
    #    default n

endif
```
